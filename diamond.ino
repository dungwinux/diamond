#include <stdint.h>

constexpr uint8_t convert(uint8_t q) {
  switch (q) {
    case 'A' ... 'Z':
      return q - 'A';
    case 'a' ... 'z':
      return q - 'a' + 26;
    case '0' ... '9':
      return q - '0' + 52;
    case '+':
      return 62;
    case '/':
      return 63;
    case '=':
      return 0;
    default:
      return 63;
  }
}

namespace variadic_toolbox {
template<unsigned count, template<unsigned...> class meta_functor,
         unsigned... indices>
struct apply_range {
  typedef typename apply_range<count - 1, meta_functor, count - 1,
                               indices...>::result result;
};

template<template<unsigned...> class meta_functor, unsigned... indices>
struct apply_range<0, meta_functor, indices...> {
  typedef typename meta_functor<indices...>::result result;
};
}  // namespace variadic_toolbox

namespace compile_time {
template<char... str>
struct string {
  static constexpr const uint8_t chars[sizeof...(str) + 1] = { convert(str)...,
                                                               '\0' };
};
template<typename lambda_str_type>
struct string_builder {
  template<unsigned... indices>
  struct produce {
    typedef string<lambda_str_type{}.chars[indices]...> result;
  };
};
}  // namespace compile_time

#define CSTRING(string_literal) \
  [] { \
    struct constexpr_string_type { \
      const char *chars = string_literal; \
    }; \
    return variadic_toolbox::apply_range< \
      sizeof(string_literal) - 1, \
      compile_time::string_builder<constexpr_string_type>::produce>:: \
      result{}; \
  }()

extern "C" {

  uint8_t *secret(uint8_t *a, uint8_t const *b) noexcept {
    int ai = 0;
    for (int bi = 0; b[bi] != 0; ai += 3, bi += 4) {
      a[ai] = ((b[bi] & 0b111111) << 2) | ((b[bi + 1] >> 4) & 0b11);
      a[ai + 1] = ((b[bi + 1] & 0b1111) << 4) | ((b[bi + 2] >> 2) & 0b1111);
      a[ai + 2] = ((b[bi + 2] & 0b11) << 6) | (b[bi + 3] & 0b111111);
    }
    if (ai != 0) a[ai] = 0;
    return a;
  }
}

#define K1234 CSTRING("VU1BU1N7VEgzXzRXMzUwTTNfODQ1MzY0XzFOX0VTUDgyNjZ9").chars
uint8_t tmp[0x30];

#define IIID reinterpret_cast<char const *>(secret(tmp, K1234))

// #include <stdio.h>
// int main() { puts(reinterpret_cast<char *>(secret(t, q))); }

#include <ESP8266WiFi.h>
#include <WiFiClient.h>
#include <ESP8266WebServer.h>
#include <ESP8266mDNS.h>

#ifndef STASSID
#define STASSID "umassctf"
#define STAPSK IIID
#endif

const char *ssid = STASSID;
const char *password = STAPSK;

ESP8266WebServer server(80);

const int led = 13;

inline void handleRoot() {
  digitalWrite(led, 1);
  server.send(200, "text/plain", "Welcome to UMassCTF network!\r\n");
  digitalWrite(led, 0);
}

inline void handleNotFound() {
  digitalWrite(led, 1);
  server.send(404, "text/plain", "File Not Found\n\n");
  digitalWrite(led, 0);
}

void setup(void) {
  pinMode(led, OUTPUT);
  digitalWrite(led, 0);
  Serial.begin(115200);
  WiFi.mode(WIFI_STA);
  WiFi.begin(ssid, password);
  Serial.println("");

  // Wait for connection
  while (WiFi.status() != WL_CONNECTED) {
    delay(500);
    Serial.print(".");
  }
  Serial.println("");
  Serial.print("Network connected via ");
  Serial.println(ssid);
  Serial.print("IP address: ");
  Serial.println(WiFi.localIP());

  if (MDNS.begin("secret8266")) { Serial.println("MDNS responder started"); }

  server.on("/", handleRoot);

  server.on("/gif", []() {
    static constexpr uint8_t gif[] PROGMEM = {
      0x47, 0x49, 0x46, 0x38, 0x39, 0x61, 0x20, 0x00, 0x20, 0x00, 0x70, 0x00,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 0x3B
    };
    // Set the background to a random set of colors
    server.send(200, "image/gif", gif, sizeof(gif));
  });

  server.onNotFound(handleNotFound);
  server.begin();
  Serial.println("HTTP server started");
}

void loop(void) {
  server.handleClient();
  MDNS.update();
}
